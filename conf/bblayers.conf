## conf/bblayers.conf
```bitbake
TOPDIR := '${@os.path.dirname(os.path.dirname(FILE))}'
BBPATH = '${TOPDIR}:${HOME}/.oe'
BBFILES = ''
BBLAYERS = '\
    ${TOPDIR}/sources/oe-core/meta \
    ${TOPDIR}/sources/meta-micro \
'
LCONF_VERSION = '4'
```

## conf/local.conf
```bitbake
CONF_VERSION = '1'

MACHINE = 'qemux86'
DISTRO = 'micro'

# Host-specific local settings
HOSTNAME := '${@os.uname()[1]}'
include conf/local/${HOSTNAME}.conf
```
